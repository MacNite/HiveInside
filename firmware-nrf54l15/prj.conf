## CMakeLists.txt
```
# HiveInside — XIAO nRF54L15 Sense firmware (nRF Connect SDK / Zephyr).
#
# Build target board: xiao_nrf54l15/nrf54l15/cpuapp
#
#   west build -b xiao_nrf54l15/nrf54l15/cpuapp firmware-nrf54l15
#
# or use the "Add build configuration" button in the nRF Connect for VS Code
# extension and pick that board target.
cmake_minimum_required(VERSION 3.20.0)

find_package(Zephyr REQUIRED HINTS $ENV{ZEPHYR_BASE})
project(hiveinside_nrf54l15)

target_sources(app PRIVATE src/main.c)
```

## prj.conf
```kconfig
# HiveInside nRF54L15 — Step 1: blinky.
#
# Deliberately minimal. We only need the GPIO driver to drive the on-board LED.
# Everything else (BLE, PDM mic, IMU, CMSIS-DSP FFT, power management) gets
# layered on in later steps — see firmware-nrf54l15/README.md for the roadmap.
CONFIG_GPIO=y

# Console/log over the USB CDC-ACM or UART so `west build -t menuconfig` and
# printk() output are visible during bring-up. Comment out for lowest power.
CONFIG_LOG=y
CONFIG_PRINTK=y
```

## src/main.c
```c
/*
 * HiveInside — XIAO nRF54L15 Sense bring-up: Step 1, blinky.
 *
 * Goal of this step: prove the toolchain, the board target and the flashing
 * path all work end-to-end before any sensors or BLE are involved. If the
 * on-board user LED blinks, your nRF Connect SDK setup is good.
 *
 * Board target: xiao_nrf54l15/nrf54l15/cpuapp
 *
 * We drive the LED through the `led0` devicetree alias that the Seeed board
 * files provide. The LED's active-low wiring (XIAO user LEDs are active-low)
 * is encoded as a GPIO_ACTIVE_LOW flag in the board's devicetree, so we toggle
 * *logically* and let Zephyr translate to the right electrical level. That is
 * why this file has no board-specific pin numbers — it is portable by design.
 */
#include <zephyr/kernel.h>
#include <zephyr/drivers/gpio.h>

#define BLINK_PERIOD_MS 500

/* Resolved at build time from devicetree: DT_ALIAS(led0) -> the board's LED. */
static const struct gpio_dt_spec led = GPIO_DT_SPEC_GET(DT_ALIAS(led0), gpios);

int main(void)
{
	if (!gpio_is_ready_dt(&led)) {
		printk("LED gpio device not ready\n");
		return 0;
	}

	if (gpio_pin_configure_dt(&led, GPIO_OUTPUT_ACTIVE) < 0) {
		printk("Failed to configure LED gpio\n");
		return 0;
	}

	printk("HiveInside nRF54L15 blinky up — toggling led0 every %d ms\n",
	       BLINK_PERIOD_MS);

	while (1) {
		gpio_pin_toggle_dt(&led);
		k_msleep(BLINK_PERIOD_MS);
	}

	return 0;
}
```
